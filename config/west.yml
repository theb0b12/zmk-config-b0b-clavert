## config/west.yml
```yaml
manifest:
  remotes:
    - name: zmkfirmware
      url-base: https://github.com/zmkfirmware
    - name: petejohanson
      url-base: https://github.com/petejohanson
    - name: infused-kim
      url-base: https://github.com/infused-kim

  projects:
    - name: zmk
      remote: petejohanson
      revision: feat/pointers-move-scroll
      import: app/west.yml

    # PS/2 mouse & TrackPoint driver module
    - name: kb_zmk_ps2_mouse_trackpoint_driver
      remote: infused-kim
      revision: main

  self:
    path: config
```
