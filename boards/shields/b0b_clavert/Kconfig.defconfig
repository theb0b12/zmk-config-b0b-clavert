## boards/shields/b0b_clavert/Kconfig.defconfig
```kconfig
if SHIELD_B0B_CLAVERT_LEFT

# Name must be less than 16 characters long!
config ZMK_KEYBOARD_NAME
    default "b0b-clavert"

config ZMK_SPLIT_ROLE_CENTRAL
    default y

config ZMK_SPLIT_BLE_CENTRAL_PERIPHERALS
  default 1

config BT_MAX_CONN
  default 6

config BT_MAX_PAIRED
  default 6

endif

if SHIELD_B0B_CLAVERT_LEFT || SHIELD_B0B_CLAVERT_RIGHT

config ZMK_SPLIT
    default y

endif

# --- Pinctrl Kconfig for part "right" ---
if BOARD_NICE_NANO_V2 && SHIELD_B0B_CLAVERT_RIGHT

config SPI
    default y

endif
```

## boards/shields/b0b_clavert/Kconfig.shield
```kconfig
config SHIELD_B0B_CLAVERT_LEFT
    def_bool $(shields_list_contains,b0b_clavert_left)

config SHIELD_B0B_CLAVERT_RIGHT
    def_bool $(shields_list_contains,b0b_clavert_right)
```
